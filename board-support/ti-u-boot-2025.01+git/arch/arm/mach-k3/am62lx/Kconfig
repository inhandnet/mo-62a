## board-support/ti-u-boot-2025.01+git/arch/arm/mach-k3/am62lx/Kconfig
```kconfig
# SPDX-License-Identifier: GPL-2.0+
#
# Copyright (C) 2025 Texas Instruments Incorporated - https://www.ti.com/
#

if SOC_K3_AM62L3

choice
	prompt "TI K3 AM62Lx based boards"
	optional

config TARGET_AM62L3_EVM
	bool "TI K3 based AM62L5 EVM"
	select ARM64
	select BINMAN
	select OF_UPSTREAM
	select OF_SYSTEM_SETUP

endchoice

source "board/ti/am62lx/Kconfig"

endif
```

## board-support/ti-u-boot-2025.01+git/board/ti/am62lx/Kconfig
```kconfig
# SPDX-License-Identifier: GPL-2.0+
#
# Copyright (C) 2025 Texas Instruments Incorporated - https://www.ti.com/
#

if TARGET_AM62L3_EVM

config SYS_BOARD
       default "am62lx"

config SYS_VENDOR
       default "ti"

config SYS_CONFIG_NAME
       default "am62l3_evm"

source "board/ti/common/Kconfig"

endif
```

## board-support/ti-u-boot-2025.01+git/configs/am62dx_evm_a53_defconfig
```kconfig
#include <configs/am62ax_evm_a53_defconfig>

CONFIG_ARM=y
CONFIG_ARCH_K3=y
CONFIG_SOC_K3_AM62A7=y
CONFIG_TARGET_AM62D2_A53_EVM=y
CONFIG_DEFAULT_DEVICE_TREE="ti/k3-am62d2-evm"
CONFIG_NET_RANDOM_ETHADDR=y
```

## board-support/ti-u-boot-2025.01+git/configs/am62dx_evm_r5_defconfig
```kconfig
#include <configs/am62ax_evm_r5_defconfig>

CONFIG_ARM=y
CONFIG_ARCH_K3=y
CONFIG_SOC_K3_AM62A7=y
CONFIG_TARGET_AM62D2_R5_EVM=y
CONFIG_DEFAULT_DEVICE_TREE="k3-am62d2-r5-evm"
```

## board-support/ti-u-boot-2025.01+git/configs/am62x_lpsk_a53_defconfig
```kconfig
#include <configs/am62x_evm_a53_defconfig>

CONFIG_ARM=y
CONFIG_ARCH_K3=y
CONFIG_DEFAULT_DEVICE_TREE="ti/k3-am62-lp-sk"
CONFIG_OF_UPSTREAM=y
CONFIG_SOC_K3_AM625=y
CONFIG_TARGET_AM625_A53_EVM=y
CONFIG_SPL_MTD=y
CONFIG_SPL_MTD_LOAD=y
CONFIG_SYS_MTD_U_BOOT_OFFS=0x280000
CONFIG_SPL_NAND_SPI_SUPPORT=y
CONFIG_CMD_MTD=y
CONFIG_SPL_DM_DEVICE_REMOVE=y
CONFIG_DM_MTD=y
CONFIG_DFU_MTD=y
CONFIG_MTD_SPI_NAND=y
```

## board-support/ti-u-boot-2025.01+git/configs/am62x_lpsk_a53_ethboot_defconfig
```kconfig
#include <configs/am62x_lpsk_a53_defconfig>

CONFIG_ARM=y
CONFIG_ARCH_K3=y
CONFIG_SOC_K3_AM625=y
CONFIG_TARGET_AM625_A53_EVM=y
CONFIG_DEFAULT_DEVICE_TREE="ti/k3-am62-lp-sk"
CONFIG_SPL_STACK_R_ADDR=0x82000000
CONFIG_SPL_DRIVERS_MISC=y
CONFIG_SPL_DMA=y
CONFIG_SPL_ETH=y
CONFIG_SPL_NET=y
CONFIG_SPL_NET_VCI_STRING="AM62X-LPSK U-Boot A53 SPL"
CONFIG_DFU=n
CONFIG_USB=n
```

## board-support/ti-u-boot-2025.01+git/configs/am62x_lpsk_r5_defconfig
```kconfig
#include <configs/am62x_evm_r5_defconfig>

CONFIG_ARM=y
CONFIG_ARCH_K3=y
CONFIG_DEFAULT_DEVICE_TREE="k3-am62-r5-lp-sk"
CONFIG_SOC_K3_AM625=y
CONFIG_TARGET_AM625_R5_EVM=y
CONFIG_SPL_MTD=y
CONFIG_SPL_MTD_LOAD=y
CONFIG_SPL_NAND_SPI_SUPPORT=y
CONFIG_SPL_DM_DEVICE_REMOVE=y
CONFIG_DM_MTD=y
CONFIG_MTD_SPI_NAND=y
```

## board-support/ti-u-boot-2025.01+git/configs/am62x_lpsk_r5_ethboot_defconfig
```kconfig
#include<configs/am62x_lpsk_r5_defconfig>

CONFIG_ARM=y
CONFIG_ARCH_K3=y
CONFIG_SOC_K3_AM625=y
CONFIG_TARGET_AM625_R5_EVM=y
CONFIG_DEFAULT_DEVICE_TREE="k3-am62-r5-lp-sk"
CONFIG_SPL_GPIO=y
CONFIG_SPL_BOARD_INIT=y
CONFIG_SPL_DMA=y
CONFIG_SPL_ENV_SUPPORT=y
CONFIG_SPL_ETH=y
CONFIG_SPL_I2C=y
CONFIG_SPL_NET=y
CONFIG_SPL_NET_VCI_STRING="AM62X-LPSK U-Boot R5 SPL"
CONFIG_DMA_CHANNELS=y
CONFIG_TI_K3_NAVSS_UDMA=y
CONFIG_TI_AM65_CPSW_NUSS=y
CONFIG_MMC=n
CONFIG_SPI=n
CONFIG_SPL_SPI=n
CONFIG_MTD=n
CONFIG_SPL_MTD=n
CONFIG_MMC=n
CONFIG_DM_MMC=n
CONFIG_SPL_DM_SPI=n
CONFIG_SPL_DM_SPI_FLASH=n
CONFIG_SPL_YMODEM_SUPPORT=n
```

## board-support/ti-u-boot-2025.01+git/configs/j722s_evm_r5_hsmboot_defconfig
```kconfig
#include<configs/j722s_evm_r5_defconfig>

CONFIG_ARM=y
CONFIG_ARCH_K3=y
CONFIG_SOC_K3_J722S=y
CONFIG_TARGET_J722S_R5_EVM=y
CONFIG_DEFAULT_DEVICE_TREE="k3-j722s-r5-evm"
# Enable HSM loading
CONFIG_K3_HSM_FW=y
CONFIG_CUSTOM_SYS_INIT_SP_ADDR=0x43C78800
CONFIG_SPL_TEXT_BASE=0x43c40000
CONFIG_SPL_BSS_START_ADDR=0x43c7c290
# Remove SPI configs to reduce SPL size
CONFIG_SPL_GPIO=n
CONFIG_DM_GPIO=n
CONFIG_SPL_SPI_FLASH_SUPPORT=n
CONFIG_SPL_SPI=n
CONFIG_OF_BOARD_SETUP=n
CONFIG_SPL_MTD=n
CONFIG_SPL_MTD_LOAD=n
CONFIG_SPL_NAND_SPI_SUPPORT=n
CONFIG_SPL_SPI_FLASH_SFDP_SUPPORT=n
CONFIG_SPL_SPI_LOAD=n
CONFIG_DA8XX_GPIO=n
CONFIG_DM_PCA953X=n
CONFIG_SPL_DM_PCA953X=n
CONFIG_MTD=n
CONFIG_DM_MTD=n
CONFIG_MTD_SPI_NAND=n
CONFIG_DM_SPI_FLASH=n
CONFIG_SPI_FLASH_SFDP_SUPPORT=n
CONFIG_SPI_FLASH_SOFT_RESET=n
CONFIG_SPI_FLASH_SOFT_RESET_ON_BOOT=n
CONFIG_SPI_FLASH_SPANSION=n
CONFIG_SPI_FLASH_S28HX_T=n
CONFIG_SPI=n
CONFIG_DM_SPI=n
CONFIG_CADENCE_QSPI=n
CONFIG_CADENCE_QSPI_PHY=n
CONFIG_SPL_DM_SPI_FLASH=n
CONFIG_SPL_DM_SPI=n
```

## board-support/ti-u-boot-2025.01+git/drivers/dma/ti/Kconfig
```kconfig
# SPDX-License-Identifier: GPL-2.0+

if ARCH_K3

config TI_K3_NAVSS_UDMA
        bool "Texas Instruments UDMA"
        depends on ARCH_K3
        select DMA
        select TI_K3_NAVSS_RINGACC
        select TI_K3_NAVSS_PSILCFG
        select TI_K3_PSIL
        help
          Support for UDMA used in K3 devices.

config TI_K3_UDMA_AM62L
        bool "Texas Instruments UDMA for AM62L"
        depends on ARCH_K3
        select DMA
        select TI_K3_NAVSS_RINGACC
        select TI_K3_NAVSS_PSILCFG
        select TI_K3_PSIL
        help
          Support for low cost UDMA variant present on AM62L. Also
	  referred to as BCDMA_V2/PKTDMA_V2.

endif

config TI_K3_PSIL
	bool
```
