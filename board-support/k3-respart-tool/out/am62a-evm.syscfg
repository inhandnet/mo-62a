/**
 * @cliArgs --device "AM62Ax" --part "Default" --package "AMB" --product "K3-RESOURCE-CONFIGURATION@1.0.0"
 * @versions {"tool":"1.21.2+3837"}
 */

/**
 * Import the modules used in this configuration.
 */
const A53_2             = scripting.addModule("/modules/am62a/A53_2");
const C7X_0_0           = scripting.addModule("/modules/am62a/C7X_0_0");
const MAIN_0_R5_1       = scripting.addModule("/modules/am62a/MAIN_0_R5_1");
const MCU_0_R5_0        = scripting.addModule("/modules/am62a/MCU_0_R5_0");
const qosConfig         = scripting.addModule("/modules/qosConfig", {}, false);
const qosConfig1        = qosConfig.addInstance();
const resourceSharing   = scripting.addModule("/modules/resourceSharing", {}, false);
const resourceSharing1  = resourceSharing.addInstance();
const resourceSharing2  = resourceSharing.addInstance();
const resourceSharing3  = resourceSharing.addInstance();
const resourceSharing4  = resourceSharing.addInstance();
const resourceSharing5  = resourceSharing.addInstance();
const resourceSharing6  = resourceSharing.addInstance();
const resourceSharing7  = resourceSharing.addInstance();
const resourceSharing8  = resourceSharing.addInstance();
const resourceSharing9  = resourceSharing.addInstance();
const resourceSharing10 = resourceSharing.addInstance();
const resourceSharing11 = resourceSharing.addInstance();

/**
 * Write custom configuration values to the imported modules.
 */
A53_2.allocOrder                                           = 1;
A53_2.Compare_event_Interrupt_Router_count                 = 16;
A53_2.DMASS_Interrupt_aggregator_Global_events_count       = 512;
A53_2.DMASS_Packet_DMA_Rings_for_SA2UL_Tx_channel1_count   = 8;
A53_2.DMASS_Packet_DMA_Rings_for_SA2UL_Rx_channel2_count   = 8;
A53_2.DMASS_Packet_DMA_Rings_for_SA2UL_Rx_channel3_count   = 8;
A53_2.DMASS_Packet_DMA_SA2UL_Tx_channel1_count             = 1;
A53_2.DMASS_Packet_DMA_SA2UL_Rx_channel2_count             = 1;
A53_2.DMASS_Packet_DMA_SA2UL_Rx_channel3_count             = 1;
A53_2.DMASS_Packet_DMA_virt_id_range_start                 = 2;
A53_2.DMASS_Packet_DMA_virt_id_range_count                 = 2;
A53_2.DMASS_Packet_DMA_Rings_for_CPSW_Tx_channel_count     = 64;
A53_2.DMASS_Packet_DMA_Rings_for_CPSW_Rx_channel_count     = 16;
A53_2.Block_Copy_DMA_Block_copy_channel_count              = 18;
A53_2.Block_Copy_DMA_Split_TR_Tx_channel_count             = 12;
A53_2.Block_Copy_DMA_Split_TR_Rx_channel_count             = 18;
A53_2.DMASS_Packet_DMA_Free_Tx_channel_count               = 10;
A53_2.DMASS_Packet_DMA_Free_Rx_channel_count               = 10;
A53_2.DMASS_Packet_DMA_CPSW_Tx_channel_count               = 8;
A53_2.DMASS_Packet_DMA_CPSW_Rx_channel_count               = 1;
A53_2.DMASS_Packet_DMA_SA2UL_Tx_channel0_count             = 1;
A53_2.DMASS_Packet_DMA_SA2UL_Rx_channel0_count             = 1;
A53_2.DMASS_Packet_DMA_SA2UL_Rx_channel1_count             = 1;
A53_2.DMASS_Packet_DMA_Rings_for_SA2UL_Rx_channel0_count   = 8;
A53_2.DMASS_Packet_DMA_Rings_for_SA2UL_Tx_channel0_count   = 8;
A53_2.DMASS_Packet_DMA_Rings_for_SA2UL_Rx_channel1_count   = 8;
A53_2.MAIN_GPIO_Interrupt_Router_count                     = 16;
A53_2.DMASS1_Interrupt_aggregator_Virtual_interrupts_count = 8;
A53_2.DMASS1_Interrupt_aggregator_Global_events_count      = 128;
A53_2.Block_Copy_DMA_DMASS1_Split_TR_Rx_channel_count      = 6;
A53_2.DMASS_Interrupt_aggregator_Virtual_interrupts_count  = 26;
A53_2.WKUP_MCU_GPIO_Interrupt_Router_count                 = 2;

C7X_0_0.DMASS_Interrupt_aggregator_Virtual_interrupts_count = 8;
C7X_0_0.allocOrder                                          = 4;
C7X_0_0.DMASS_Interrupt_aggregator_Global_events_count      = 128;

MAIN_0_R5_1.allocOrder                                          = 2;
MAIN_0_R5_1.DMASS_Interrupt_aggregator_Global_events_count      = 256;
MAIN_0_R5_1.shareResource                                       = "MAIN_0_R5_0";
MAIN_0_R5_1.Block_Copy_DMA_Block_copy_channel_count             = 6;
MAIN_0_R5_1.Block_Copy_DMA_Split_TR_Rx_channel_count            = 6;
MAIN_0_R5_1.Block_Copy_DMA_Split_TR_Tx_channel_count            = 6;
MAIN_0_R5_1.DMASS_Packet_DMA_Free_Tx_channel_count              = 3;
MAIN_0_R5_1.DMASS_Packet_DMA_Free_Rx_channel_count              = 3;
MAIN_0_R5_1.Compare_event_Interrupt_Router_count                = 4;
MAIN_0_R5_1.WKUP_MCU_GPIO_Interrupt_Router_count                = 2;
MAIN_0_R5_1.DMASS_Interrupt_aggregator_Virtual_interrupts_count = 35;

MCU_0_R5_0.allocOrder                                          = 3;
MCU_0_R5_0.Block_Copy_DMA_Block_copy_channel_count             = 2;
MCU_0_R5_0.Block_Copy_DMA_Split_TR_Rx_channel_count            = 2;
MCU_0_R5_0.Block_Copy_DMA_Split_TR_Tx_channel_count            = 2;
MCU_0_R5_0.DMASS_Packet_DMA_Free_Tx_channel_count              = 3;
MCU_0_R5_0.DMASS_Packet_DMA_Free_Rx_channel_count              = 3;
MCU_0_R5_0.Compare_event_Interrupt_Router_count                = 22;
MCU_0_R5_0.MAIN_GPIO_Interrupt_Router_count                    = 2;
MCU_0_R5_0.WKUP_MCU_GPIO_Interrupt_Router_count                = 4;
MCU_0_R5_0.DMASS_Interrupt_aggregator_Global_events_count      = 128;
MCU_0_R5_0.DMASS_Interrupt_aggregator_Virtual_interrupts_count = 8;

qosConfig1.$name      = "modules_qosConfig0";
qosConfig1.deviceName = "K3_DSS_UL_MAIN_0";
qosConfig1.orderId    = 8;

resourceSharing1.$name              = "modules_resourceSharing0";
resourceSharing1.resourceName       = "DMASS Packet DMA CPSW Tx channel";
resourceSharing1.sharedFromHostName = "A53_2";
resourceSharing1.sharedToHostName   = "MCU_0_R5_0";

resourceSharing2.$name              = "modules_resourceSharing1";
resourceSharing2.resourceName       = "DMASS Packet DMA Rings for CPSW Rx channel";
resourceSharing2.sharedFromHostName = "A53_2";
resourceSharing2.sharedToHostName   = "MCU_0_R5_0";

resourceSharing3.$name              = "modules_resourceSharing2";
resourceSharing3.resourceName       = "DMASS Packet DMA CPSW Rx flows";
resourceSharing3.sharedFromHostName = "A53_2";
resourceSharing3.sharedToHostName   = "MCU_0_R5_0";

resourceSharing4.$name              = "modules_resourceSharing3";
resourceSharing4.sharedFromHostName = "A53_2";
resourceSharing4.resourceName       = "DMASS Packet DMA Rings for CPSW Tx channel";
resourceSharing4.sharedToHostName   = "MCU_0_R5_0";

resourceSharing5.$name              = "modules_resourceSharing4";
resourceSharing5.resourceName       = "DMASS Packet DMA CPSW Rx channel";
resourceSharing5.sharedFromHostName = "A53_2";
resourceSharing5.sharedToHostName   = "MCU_0_R5_0";

resourceSharing6.$name              = "modules_resourceSharing5";
resourceSharing6.resourceName       = "Block Copy DMA Split TR Rx channel";
resourceSharing6.sharedFromHostName = "MAIN_0_R5_1";
resourceSharing6.sharedToHostName   = "C7X_0_0";

resourceSharing7.$name              = "modules_resourceSharing6";
resourceSharing7.resourceName       = "Block Copy DMA Rings for Split TR Tx channel";
resourceSharing7.sharedFromHostName = "MAIN_0_R5_1";
resourceSharing7.sharedToHostName   = "C7X_0_0";

resourceSharing8.$name              = "modules_resourceSharing7";
resourceSharing8.resourceName       = "Block Copy DMA Block copy channel";
resourceSharing8.sharedFromHostName = "MAIN_0_R5_1";
resourceSharing8.sharedToHostName   = "C7X_0_0";

resourceSharing9.$name              = "modules_resourceSharing8";
resourceSharing9.resourceName       = "Block Copy DMA Rings for Block copy channel";
resourceSharing9.sharedFromHostName = "MAIN_0_R5_1";
resourceSharing9.sharedToHostName   = "C7X_0_0";

resourceSharing10.$name              = "modules_resourceSharing9";
resourceSharing10.resourceName       = "Block Copy DMA Rings for Split TR Rx channel";
resourceSharing10.sharedFromHostName = "MAIN_0_R5_1";
resourceSharing10.sharedToHostName   = "C7X_0_0";

resourceSharing11.$name              = "modules_resourceSharing10";
resourceSharing11.resourceName       = "Block Copy DMA Split TR Tx channel";
resourceSharing11.sharedFromHostName = "MAIN_0_R5_1";
resourceSharing11.sharedToHostName   = "C7X_0_0";
