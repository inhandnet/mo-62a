// SPDX-License-Identifier: GPL-2.0
/*
 * DT Overlay for MO-62A 40-pin expansion header — EHRPWM0 mode
 *
 * Enables EHRPWM0 on 40-pin header:
 *   Pins 32,33: EHRPWM0_B/A (GPIO1_14/13)
 *
 * GPIO1 pinctrl updated to exclude EHRPWM0 pins (GPIO1_13/14).
 * All other 40-pin header pins remain GPIO.
 *
 * Note: EHRPWM1_A (Pin 36) remains GPIO — epwm1 is used for fan connector.
 *
 * Usage: add to extlinux.conf label:
 *   fdtoverlays /ti/k3-am62a7-mo-62a-exp-ehrpwm0.dtbo
 */

/dts-v1/;
/plugin/;

#include "k3-pinctrl.h"
#define PIN_DRIVE_STRENGTH_NOMINAL 0

/* Reduced GPIO1 pinctrl — excludes EHRPWM0 pins (GPIO1_13/14) */
&main_pmx0 {
	gpio1_ehrpwm0_mode_pins: gpio1-ehrpwm0-mode-pins {
		pinctrl-single,pins = <
			AM62AX_IOPAD(0x0178, PIN_INPUT|PIN_DRIVE_STRENGTH_NOMINAL, 7) /* GPIO1_0  EXP Pin12 */
			AM62AX_IOPAD(0x017c, PIN_INPUT|PIN_DRIVE_STRENGTH_NOMINAL, 7) /* GPIO1_1  AUD_RSTn */
			AM62AX_IOPAD(0x0180, PIN_INPUT|PIN_DRIVE_STRENGTH_NOMINAL, 7) /* GPIO1_2  EXP Pin40 */
			AM62AX_IOPAD(0x0188, PIN_INPUT|PIN_DRIVE_STRENGTH_NOMINAL, 7) /* GPIO1_4 */
			AM62AX_IOPAD(0x018c, PIN_INPUT|PIN_DRIVE_STRENGTH_NOMINAL, 7) /* GPIO1_5  EXP Pin38 */
			AM62AX_IOPAD(0x0190, PIN_INPUT|PIN_DRIVE_STRENGTH_NOMINAL, 7) /* GPIO1_6  ETHINTn */
			AM62AX_IOPAD(0x0194, PIN_INPUT, 7)                             /* GPIO1_7  EEP_WC */
			AM62AX_IOPAD(0x019c, PIN_INPUT|PIN_DRIVE_STRENGTH_NOMINAL, 7) /* GPIO1_9 */
			/* GPIO1_13 (0x01ac) excluded — claimed by EHRPWM0_A */
			/* GPIO1_14 (0x01b0) excluded — claimed by EHRPWM0_B */
			AM62AX_IOPAD(0x01b4, PIN_INPUT|PIN_DRIVE_STRENGTH_NOMINAL, 7) /* GPIO1_15 EXP Pin24 */
			AM62AX_IOPAD(0x01b8, PIN_INPUT|PIN_DRIVE_STRENGTH_NOMINAL, 7) /* GPIO1_16 EXP Pin26 */
			AM62AX_IOPAD(0x01bc, PIN_INPUT|PIN_DRIVE_STRENGTH_NOMINAL, 7) /* GPIO1_17 EXP Pin23 */
			AM62AX_IOPAD(0x01c0, PIN_INPUT|PIN_DRIVE_STRENGTH_NOMINAL, 7) /* GPIO1_18 EXP Pin19 */
			AM62AX_IOPAD(0x01c4, PIN_INPUT|PIN_DRIVE_STRENGTH_NOMINAL, 7) /* GPIO1_19 EXP Pin21 */
			AM62AX_IOPAD(0x01d0, PIN_INPUT|PIN_DRIVE_STRENGTH_NOMINAL, 7) /* GPIO1_22 EXP Pin15 */
			AM62AX_IOPAD(0x01d4, PIN_INPUT|PIN_DRIVE_STRENGTH_NOMINAL, 7) /* GPIO1_23 EXP Pin11 */
			AM62AX_IOPAD(0x01d8, PIN_INPUT|PIN_DRIVE_STRENGTH_NOMINAL, 7) /* GPIO1_24 EXP Pin10 */
			AM62AX_IOPAD(0x01dc, PIN_INPUT|PIN_DRIVE_STRENGTH_NOMINAL, 7) /* GPIO1_25 EXP Pin8 */
			AM62AX_IOPAD(0x01f4, PIN_INPUT|PIN_DRIVE_STRENGTH_NOMINAL, 7) /* GPIO1_31 EXTINTn */
		>;
	};
};

&main_gpio1 {
	pinctrl-names = "default";
	pinctrl-0 = <&gpio1_ehrpwm0_mode_pins>;
};

/* Pins 32,33 — EHRPWM0_B/A */
&epwm0 {
	status = "okay";
	pinctrl-names = "default";
	pinctrl-0 = <&main_ehtpwm0_pins_default>;
};
