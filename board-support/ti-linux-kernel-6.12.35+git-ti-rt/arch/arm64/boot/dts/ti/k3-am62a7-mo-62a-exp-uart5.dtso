// SPDX-License-Identifier: GPL-2.0
/*
 * DT Overlay for MO-62A 40-pin expansion header — UART5 mode
 *
 * Enables UART5 on 40-pin header:
 *   Pins  8,10: UART5 TXD/RXD (GPIO1_25/24)
 *
 * GPIO1 pinctrl updated to exclude UART5 pins (GPIO1_24/25).
 * All other 40-pin header pins remain GPIO.
 *
 * Usage: add to extlinux.conf label:
 *   fdtoverlays /ti/k3-am62a7-mo-62a-exp-uart5.dtbo
 */

/dts-v1/;
/plugin/;

#include "k3-pinctrl.h"
#define PIN_DRIVE_STRENGTH_NOMINAL 0

/* Reduced GPIO1 pinctrl — excludes UART5 pins (GPIO1_24/25) */
&main_pmx0 {
	gpio1_uart5_mode_pins: gpio1-uart5-mode-pins {
		pinctrl-single,pins = <
			AM62AX_IOPAD(0x0178, PIN_INPUT|PIN_DRIVE_STRENGTH_NOMINAL, 7) /* GPIO1_0  EXP Pin12 */
			AM62AX_IOPAD(0x017c, PIN_INPUT|PIN_DRIVE_STRENGTH_NOMINAL, 7) /* GPIO1_1  AUD_RSTn */
			AM62AX_IOPAD(0x0180, PIN_INPUT|PIN_DRIVE_STRENGTH_NOMINAL, 7) /* GPIO1_2  EXP Pin40 */
			AM62AX_IOPAD(0x0188, PIN_INPUT|PIN_DRIVE_STRENGTH_NOMINAL, 7) /* GPIO1_4 */
			AM62AX_IOPAD(0x018c, PIN_INPUT|PIN_DRIVE_STRENGTH_NOMINAL, 7) /* GPIO1_5  EXP Pin38 */
			AM62AX_IOPAD(0x0190, PIN_INPUT|PIN_DRIVE_STRENGTH_NOMINAL, 7) /* GPIO1_6  ETHINTn */
			AM62AX_IOPAD(0x0194, PIN_INPUT, 7)                             /* GPIO1_7  EEP_WC */
			AM62AX_IOPAD(0x019c, PIN_INPUT|PIN_DRIVE_STRENGTH_NOMINAL, 7) /* GPIO1_9 */
			AM62AX_IOPAD(0x01ac, PIN_INPUT|PIN_DRIVE_STRENGTH_NOMINAL, 7) /* GPIO1_13 EXP Pin33 */
			AM62AX_IOPAD(0x01b0, PIN_INPUT|PIN_DRIVE_STRENGTH_NOMINAL, 7) /* GPIO1_14 EXP Pin32 */
			AM62AX_IOPAD(0x01b4, PIN_INPUT|PIN_DRIVE_STRENGTH_NOMINAL, 7) /* GPIO1_15 EXP Pin24 */
			AM62AX_IOPAD(0x01b8, PIN_INPUT|PIN_DRIVE_STRENGTH_NOMINAL, 7) /* GPIO1_16 EXP Pin26 */
			AM62AX_IOPAD(0x01bc, PIN_INPUT|PIN_DRIVE_STRENGTH_NOMINAL, 7) /* GPIO1_17 EXP Pin23 */
			AM62AX_IOPAD(0x01c0, PIN_INPUT|PIN_DRIVE_STRENGTH_NOMINAL, 7) /* GPIO1_18 EXP Pin19 */
			AM62AX_IOPAD(0x01c4, PIN_INPUT|PIN_DRIVE_STRENGTH_NOMINAL, 7) /* GPIO1_19 EXP Pin21 */
			AM62AX_IOPAD(0x01d0, PIN_INPUT|PIN_DRIVE_STRENGTH_NOMINAL, 7) /* GPIO1_22 EXP Pin15 */
			AM62AX_IOPAD(0x01d4, PIN_INPUT|PIN_DRIVE_STRENGTH_NOMINAL, 7) /* GPIO1_23 EXP Pin11 */
			/* GPIO1_24 (0x01d8) excluded — claimed by UART5_RXD */
			/* GPIO1_25 (0x01dc) excluded — claimed by UART5_TXD */
			AM62AX_IOPAD(0x01f4, PIN_INPUT|PIN_DRIVE_STRENGTH_NOMINAL, 7) /* GPIO1_31 EXTINTn */
		>;
	};
};

&main_gpio1 {
	pinctrl-names = "default";
	pinctrl-0 = <&gpio1_uart5_mode_pins>;
};

/* Pins 8,10 — UART5 TXD/RXD */
&main_uart5 {
	status = "okay";
	pinctrl-names = "default";
	pinctrl-0 = <&main_uart5_pins_default>;
};
